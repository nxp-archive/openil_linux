## Documentation/devicetree/bindings/video/fsl-dcu-fb.txt
```
* Freescale Display Control Unit (DCU)

=== For dcu node ===
Required properties:
- compatible:		Should be one of "fsl,vf610-dcu" and "fsl,ls1021a-dcu".
- reg:			Address and length of the register set for DCU.
- interrupts:		Should contain DCU interrupts.
- clocks:		From common clock binding: handle to DCU clock.
- clock-names:		From common clock binding: Shall be "dcu".
- display:		The phandle to display node.

Optional properties:
- tcon-controller:	The phandle of TCON controller.
- scfg-controller:	The phandle of scfg node.

=== For display sub-node ===
Required properties:
- bits-per-pixel:	<24> for RGB888.

Required timing node for dispplay sub-node:
- display-timings:	Refer to binding doc display-timing.txt for details.

=== For TCON node ===
Required properties:
- compatible:		Should be "fsl,tcon".
- reg:			Address and length of the register set for TCON.
- clocks:		From common clock binding: handle to TCON clock.
- clock-names:		From common clock binding: Shall be "tcon".

Examples:

dcu0: dcu@40058000 {
	compatible = "fsl,vf610-dcu";
	reg = <0x40058000 0x1200>;
	interrupts = <0 30 0x04>;
	clocks = <&clks VF610_CLK_DCU0>;
	clock-names = "dcu";
	tcon-controller = <&tcon0>;
	scfg-controller = <&scfg>;
	display = <&display>;

	display: display@0 {
		bits-per-pixel = <24>;

		display-timings {
			native-mode = <&timing0>;
			timing0: nl4827hc19 {
				clock-frequency = <10870000>;
				hactive = <480>;
				vactive = <272>;
				hback-porch = <2>;
				hfront-porch = <2>;
				vback-porch = <1>;
				vfront-porch = <1>;
				hsync-len = <41>;
				vsync-len = <2>;
				hsync-active = <1>;
				vsync-active = <1>;
			};
		};
	};
};

tcon0: tcon@4003d000 {
	compatible = "fsl,vf610-tcon";
	reg = <0x4003d000 0x1000>;
	clocks = <&clks VF610_CLK_TCON0>;
	clock-names = "tcon";
};
```

## Documentation/devicetree/bindings/video/fsl-sii902x.txt
```
Device-Tree bindings for framebuffer hdmi driver

Required properties:
- compatible: 	Should be "fsl,sii902x".
- reg: 		The I2C address of the device.
- interrupts:	Interrupt number to the cpu.

Example:

&i2c1 {
       status = "okay";
       hdmi: sii9022a@39 {
             compatible = "fsl,sii902x";
             reg = <0x39>;
             interrupts = <GIC_SPI 167 IRQ_TYPE_EDGE_RISING>;
       };
};
```

## drivers/crypto/dpaa2-caam/Kconfig
```kconfig
menuconfig FSL_DPAA2_CAAM
	tristate "Freescale DPAA2 CAAM"
	depends on FSL_MC_BUS && FSL_MC_DPIO
	default "y"
	select CRYPTO_BLKCIPHER
	---help---
	  Freescale Data Path Acceleration Architecture 2 CAAM driver,
	  using the Freescale MC bus driver.
```

## drivers/gpu/drm/imx/dcss/Kconfig
```kconfig
config DRM_IMX_DCSS
	tristate "i.MX8MQ DCSS"
	depends on ARCH_MXC
	select RESET_CONTROLLER
	select IMX_IRQSTEER
	help
	  Choose this if you have a NXP i.MX8MQ based system and want to use the
	  Display Controller Subsystem. This option enables DCSS support.
```

## drivers/irqchip/Kconfig.rej
```kconfig
--- drivers/irqchip/Kconfig
+++ drivers/irqchip/Kconfig
@@ -279,3 +279,7 @@ config EZNPS_GIC
 config STM32_EXTI
 	bool
 	select IRQ_DOMAIN
+
+config BAREMETAL
+	bool
+	depends on ARM_GIC
```

## drivers/net/bonding/Kconfig
```kconfig
config HW_DISTRIBUTION_WITH_OH
	default n
	bool "Bonding driver with h/w based Tx traffic distribuition support"
	depends on BONDING
	depends on FSL_DPAA_OFFLINE_PORTS
	---help---
	  Say 'Y' if you wish to distribute Tx data traffics based on
	  the hardware of Freescale DPAA - Offline Port PCD in your
	  mode Link Aggregation (802.3ad mode)

	  In theory, this method can offload CPU when selecting the
	  transmit hash policy to use for slave device selection.
	  if this feature can integrate with CEETM Qos, they two can
	  provide a bundle Qos rather than individual links Qos.

config HW_LAG_DEBUG
	default n
	bool "Show detailed debug information"
	depends on HW_DISTRIBUTION_WITH_OH
	---help---
	  This provide a wrapper of pr_info, which can show useful debug
	  information such as function name and line number.
	  Say 'Y' if you wish to get more details debugging information
	  at run-time, otherwise please disable it.
```

## drivers/net/tdm/Kconfig
```kconfig
#
# TDM Network devices configuration
#
menuconfig TDM_NET_DRIVERS
	tristate "TDM Network Drivers"

if TDM_NET_DRIVERS

config SLIC_DS26522
	tristate "SLIC MAXIM DS26522 CARD SUPPORT"
	default n
	---help---
	  This module initializes and configures the slic maxim card
	  in T1 or E1 mode.

endif
```

## drivers/soc/Kconfig
```kconfig
menu "SOC (System On Chip) specific Drivers"

source "drivers/soc/fsl/qe/Kconfig"
source "drivers/soc/mediatek/Kconfig"
source "drivers/soc/qcom/Kconfig"
source "drivers/soc/ti/Kconfig"
source "drivers/soc/versatile/Kconfig"

config	FSL_SOC_DRIVERS
	bool "Freescale Soc Drivers"
	depends on FSL_SOC || ARCH_MXC || ARCH_LAYERSCAPE
	default n
	help
	Say y here to enable Freescale Soc Device Drivers support.
	The Soc Drivers provides the device driver that is a specific block
	or feature on Freescale platform.

if FSL_SOC_DRIVERS
	source "drivers/soc/fsl/Kconfig"
endif

endmenu
```

## drivers/soc/fsl/Kconfig
```kconfig
#
# Freescale SOC drivers
#
config FSL_GUTS
       bool "Freescale QorIQ GUTS driver"
       select SOC_BUS

if ARM || ARM64
source "drivers/soc/fsl/Kconfig.arm"
endif
```

## drivers/soc/fsl/Kconfig.arm
```kconfig
#
# Freescale ARM SOC Drivers
#

config	LS1_SOC_DRIVERS
	bool "LS1021A Soc Drivers"
	depends on SOC_LS1021A
	default n
	help
	Say y here to enable Freescale LS1021A Soc Device Drivers support.
	The Soc Drivers provides the device driver that is a specific block
	or feature on LS1021A platform.

config LS_SOC_DRIVERS
	bool "Layerscape Soc Drivers"
	depends on ARCH_LAYERSCAPE
	default n
	help
	Say y here to enable Freescale Layerscape Soc Device Drivers support.
	The Soc Drivers provides the device driver that is a specific block
	or feature on Layerscape platform.

if LS1_SOC_DRIVERS
	source "drivers/soc/fsl/ls1/Kconfig"
endif

if LS_SOC_DRIVERS
	source "drivers/soc/fsl/ls2-console/Kconfig"
endif
```

## drivers/staging/fsl-dpaa2/dce/Kconfig
```kconfig
#
# Freescale DPAA2 Decompression Compression (DCE) driver
#
# Copyright (C) 2015 Freescale Semiconductor, Inc.
#
# This file is released under the GPLv2
#

config FSL_DPAA2_DCE
	tristate "DPAA2 Decompression Compression Engine"
	depends on FSL_DPAA2 && FSL_MC_BUS && FSL_MC_DPIO
	---help---
	  A simplified interface to DCE that allows for asynchronous
	  use of DCE without requiring complex setup

config FSL_DCE_FLOW_LIMIT
        int "Number of flows supported per compression or decompression device"
        depends on FSL_DPAA2_DCE
        default 65536
        ---help---
          This is the number of flows per compression or decompression device.
	  A hashtable is allocated to locate corresponding flow objects
	  based on a hash value.
	  This is used for both statefull and stateless flows.

config FSL_DCE_API_TIME_TRIAL
	tristate "Freescale DCE Driver API timed test"
	depends on FSL_DPAA2_DCE
	---help---
	  A DCE performance test that send as many work requests as possible in
	  a given number of seconds. When the time is up the test waits for any
	  remaining output from DCE and checks its integrity. Performance
	  numbers are then printed. The test runs in two steps. One for
	  compression and the second for decompression. The test can be packaged
	  as a loadable module and takes optional parameters that modify test
	  behavior. Please use modinfo to see the test parameters
```

## drivers/staging/fsl-dpaa2/ethernet/Kconfig
```kconfig
#
# Freescale DPAA Ethernet driver configuration
#
# Copyright (C) 2014-2015 Freescale Semiconductor, Inc.
#
# This file is released under the GPLv2
#

menuconfig FSL_DPAA2_ETH
	tristate "Freescale DPAA Ethernet"
	depends on FSL_DPAA2 && FSL_MC_BUS && FSL_MC_DPIO
	select FSL_DPAA2_MAC
	default y
	---help---
	  Freescale Data Path Acceleration Architecture Ethernet
	  driver, using the Freescale MC bus driver.

if FSL_DPAA2_ETH
config FSL_DPAA2_ETH_GCOV
	bool "Gcov support in the FSL LDPAA Ethernet driver"
	default n
	depends on GCOV_KERNEL
	---help---
	  Compile the driver source with GCOV_PROFILE := y

config FSL_DPAA2_ETH_LINK_POLL
	bool "Use polling mode for link state"
	default n
	---help---
	  Poll for detecting link state changes instead of using
	  interrupts.
endif
```

## drivers/staging/fsl-dpaa2/mac/Kconfig
```kconfig
config FSL_DPAA2_MAC
	tristate "DPAA2 MAC / PHY interface"
	depends on FSL_MC_BUS && FSL_DPAA2
	select FSL_DPAA2_FIXED_PHY_HACK
	---help---
	Prototype driver for DPAA2 MAC / PHY interface object.
	This driver works as a proxy between phylib including phy drivers and
	the MC firmware.  It receives updates on link state changes from PHY
	lib and forwards them to MC and receives interrupt from MC whenever
	a request is made to change the link state.


config FSL_DPAA2_MAC_NETDEVS
	bool "Expose net interfaces for PHYs"
	default n
	depends on FSL_DPAA2_MAC
	---help---
	Exposes macX net interfaces which allow direct control over MACs and
	PHYs.
	.
	Leave disabled if unsure.

config FSL_DPAA2_FIXED_PHY_HACK
	bool "Hack for fixed links, to remove in v3.18"
	default y
	depends on FSL_DPAA2_MAC
	---help---
	Temporary hack to allow registration of a fixed PHY without a device
	tree node and actual fixed-link property or child node.
	Plan is to remove this in kernel 3.18, it includes an updated API which
	should make this work.
```

## drivers/staging/fsl_dce/Kconfig
```kconfig
config FSL_DCE
	bool "FSL Decompression Compression Engine (DCE) support"
	depends on FSL_QMAN
	---help---
	  Say Y here to include support for the Freescale Decompression
	  Compression Engine. This accelerator can be used to offload RFC 1950
	  ZLIB, RFC 1951 DEFLATE and RFC 1952 GZIP compression and decompression
	  work. Example applications that show simple usage and measure
	  throughput are available in the DCE tests directory

config FSL_DCE_CONFIG
	bool "FSL DCE device management"
	depends on FSL_DCE
	default y
	---help---
	  Say Y here to include support for FSL DCE configuration. This is
	  separate from FSL_DCE because it should not be included in virtual
	  kernels. Only the hyper-visor would include this module in systems
	  with multiple Linux instances. In regular systems this should be a
	  built-in module

config FSL_DCE_DEBUGFS
	tristate "FSL DCE DebugFS interface"
	depends on FSL_DCE
	default y
	---help---
	  Say Y here to include debugfs interface. This interface allows reading
	  of DCE Configuration Control and Status Register (CCSR) memory. the
	  CCSR definition map is documented in the DCE block guide. DCE Address
	  offsets can be written to /sys/kernel/debug/dce/ccsrmem_addr and then
	  the value in the register can be read or written using
	  /sys/kernel/debug/dce/ccsrmem_rw

	  e.g.
	  root@t4240qds:~# echo 0x03C > /sys/kernel/debug/dce/ccsrmem_addr
	  root@t4240qds:~# cat /sys/kernel/debug/dce/ccsrmem_rw
	  DCE register offset = 0x3c
	  value = 0x00000001

config FSL_DCE_TESTS
	tristate "FSL DCE primitives tests"
	depends on FSL_DCE
	default m
	---help---
	  DCE primitives tests. Select to build DCE compression and
	  decompression tests using stateful and stateless asynchronous
	  interfaces to DCE. Use modinfo to view tests parameters
```

## drivers/staging/fsl_dpa_offload/Kconfig
```kconfig
config FSL_DPA_OFFLOAD
	tristate "Freescale Datapath Offloading Driver"
	depends on FSL_SDK_FMAN && CRYPTO_DEV_FSL_CAAM_JR
	select CRC8
	select CRC64_ECMA
	default n
	---help---
		The driver supports DPAA 1.x offloading capabilities.
		    * Classifier component makes possible the offloading of
		      classification rules and network packet updates by
		      configuring the FMAN hardware.
		    * DPA IPsec component makes possible the offloading of
		      security operations (ESP) by configuring the onboard
		      SEC.
		    * The statistics component facilitates the gathering of
		      offloading related packet and byte statistics.

		To compile this driver as a module, choose M here. The module
		will be named dpa_offload.
```

## drivers/staging/fsl_rman/Kconfig
```kconfig
config FSL_RMAN_UIO
	bool "Freescale RapidIO Message Manager support"
	depends on UIO
	default y
```
