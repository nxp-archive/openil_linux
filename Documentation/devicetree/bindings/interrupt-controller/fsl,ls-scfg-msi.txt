## Documentation/devicetree/bindings/interrupt-controller/fsl,ls-scfg-msi.txt
```
* Freescale Layerscape SCFG PCIe MSI controller

Layerscape SoCs may have one or multiple MSI controllers.
Each MSI controller must be showed as a child node.

Required properties:

- compatible: should be "fsl,ls-scfg-msi"
- #address-cells: must be 2
- #size-cells: must be 2
- ranges: allows valid 1:1 translation between child's address space and
	  parent's address space
- msi-controller: indicates that this is a PCIe MSI controller node

Required child node:
A child node must exist to represent the MSI controller.
The following are properties specific to those nodes:

- reg: physical base address of the controller and length of memory mapped.
- interrupts: an interrupt to the parent interrupt controller.

Optional properties:
- interrupt-parent: the phandle to the parent interrupt controller.


Notes:
This interrupt controller hardware is a second level interrupt controller that
is hooked to a parent interrupt controller: e.g: ARM GIC for ARM-based
platforms. If interrupt-parent is not provided, the default parent interrupt
controller will be used.
Each PCIe node needs to have property msi-parent that points to
MSI controller node

Examples:

	msi: msi-controller {
		compatible = "fsl,ls-scfg-msi";
		#address-cells = <2>;
		#size-cells = <2>;
		ranges;
		msi-controller;

		msi0@1580000 {
			reg = <0x0 0x1580000 0x0 0x10000>;
			interrupts = <0 116 0x4>,
				     <0 111 0x4>,
				     <0 112 0x4>,
				     <0 113 0x4>;
		};

		msi1@1590000 {
			reg = <0x0 0x1590000 0x0 0x10000>;
			interrupts = <0 126 0x4>,
				     <0 121 0x4>,
				     <0 122 0x4>,
				     <0 123 0x4>;
		};

		msi2@15a0000 {
			reg = <0x0 0x15a0000 0x0 0x10000>;
			interrupts = <0 160 0x4>,
				     <0 155 0x4>,
				     <0 156 0x4>,
				     <0 157 0x4>;
		};
	};

	pcie@3400000 {
			...
			msi-parent = <&msi>;
			...
	};
```

## Documentation/devicetree/bindings/powerpc/fsl/cpm_qe/network.txt
```
* Network

Currently defined compatibles:
- fsl,cpm1-scc-enet
- fsl,cpm2-scc-enet
- fsl,cpm1-fec-enet
- fsl,cpm2-fcc-enet (third resource is GFEMR)
- fsl,qe-enet

Example:

	ethernet@11300 {
		compatible = "fsl,mpc8272-fcc-enet",
			     "fsl,cpm2-fcc-enet";
		reg = <11300 20 8400 100 11390 1>;
		local-mac-address = [ 00 00 00 00 00 00 ];
		interrupts = <20 8>;
		interrupt-parent = <&PIC>;
		phy-handle = <&PHY0>;
		fsl,cpm-command = <12000300>;
	};

* MDIO

Currently defined compatibles:
fsl,pq1-fec-mdio (reg is same as first resource of FEC device)
fsl,cpm2-mdio-bitbang (reg is port C registers)

Properties for fsl,cpm2-mdio-bitbang:
fsl,mdio-pin : pin of port C controlling mdio data
fsl,mdc-pin : pin of port C controlling mdio clock

Example:
	mdio@10d40 {
		compatible = "fsl,mpc8272ads-mdio-bitbang",
			     "fsl,mpc8272-mdio-bitbang",
			     "fsl,cpm2-mdio-bitbang";
		reg = <10d40 14>;
		#address-cells = <1>;
		#size-cells = <0>;
		fsl,mdio-pin = <12>;
		fsl,mdc-pin = <13>;
	};

* HDLC

Currently defined compatibles:
- fsl,ucc_hdlc

Properties for fsl,ucc_hdlc:
rx-clock-name : which clock QE use for RX
tx-clock-name : which clock QE use for TX
fsl,rx-sync-clock : which pin QE use for RX sync
fsl,tx-sync-clock : which pin QE use for TX sync
fsl,tx-timeslot : tx timeslot
fsl,rx-timeslot : rx timeslot
fsl,tdm-framer-type : tdm framer type
fsl,tdm-mode : tdm mode, normal or internal-loopback
fsl,tdm-id : tdm ID
fsl,siram-entry-id : SI RAM entry ID for the TDM
fsl,tdm-interface : hdlc based on tdm-interface

Example:

	ucc@2000 {
		compatible = "fsl,ucc_hdlc";
		rx-clock-name = "clk8";
		tx-clock-name = "clk9";
		fsl,rx-sync-clock = "rsync_pin";
		fsl,tx-sync-clock = "tsync_pin";
		fsl,tx-timeslot = <0xfffffffe>;
		fsl,rx-timeslot = <0xfffffffe>;
		fsl,tdm-framer-type = "e1";
		fsl,tdm-mode = "normal";
		fsl,tdm-id = <0>;
		fsl,siram-entry-id = <0>;
		fsl,tdm-interface;
	};
```

## Documentation/devicetree/bindings/powerpc/fsl/cpm_qe/uqe_serial.txt
```
* Serial

Currently defined compatibles:
- ucc_uart

Properties for ucc_uart:
device_type : which type the device is
port-number : port number of UCC-UART
rx-clock-name : which clock QE use for RX
tx-clock-name : which clock QE use for TX

Example:

	serial: ucc@2200 {
		device_type = "serial";
		compatible = "ucc_uart";
		port-number = <1>;
		rx-clock-name = "brg2";
		tx-clock-name = "brg2";
	};
```

## Documentation/devicetree/bindings/powerpc/fsl/l2-switch.txt
```
T1040 L2switch Device Tree Binding
Copyright (C) 2013 Freescale Semiconductor Inc.

CONTENTS
  - Overview
  - L2switch Node
  - Port Node

=====================================================================
Overview

DESCRIPTION

    T1040 integrates a Gigabit Ethernet switch core with eight 10/100/1000 Mbps
    Ethernet ports and two 10/100/1000/2500 Mbps ports.

=====================================================================
L2switch Node

Description

    This node specifies the address range of l2switch configuration registers
    and interrupts.  It also contains a set of child nodes defining the
    Ethernet ports.

PROPERTIES

   - compatible
      Usage: required
      Value type: <string>
      Definition: Must include "vitesse-9953"

   - reg
      Usage: required
      Value type: <prop-encoded-array>
      Definition: Standard property which specifies the physical address and
      length of the l2switch configuration registers.

   - interrupts
      Usage: required
      Value type: <prop_encoded-array>
      Definition:  Standard property, specifies the interrupts generated by
           this device.
           The value of the interrupts property consists of one interrupt
           specifier.  The format of the specifier is defined by the binding
           document describing the node's interrupt parent.

=====================================================================
Port Node

Description

    This node specifies the status and connection type of each of the Ethernet
    ports.

PROPERTIES

   - compatible
     Usage: required
     Value type: <string>
     Definition: Must include "vitesse-9953-port"

   - port-index
     Usage: required
     Value type: <u32>
     Definition: Specifies the port index.  Values 0, 1 are used by the two
             internal 10/100/1000/2500 Mbps ports, values 2-9 are used by the
             eight external 10/100/1000 Mbps ports.

   - phy-connection-type
     Usage: required
     Value type: <string>
     Definition: Specifies the controller/PHY interface type.

   - status
     Usage: optional
     Value type: <string>
     Definition: Standard property.
             Indicates the operational status of the port.  "disabled" is used
             to indicate that the port is not usable (for example because the
             QSGMII link to the PHYs is not available with current RCW).

   - fixed-link
     Usage: optional
     Value type: <prop_encoded-array>
     Definition: Specifies link parameters in the absence of a PHY.
             <a b c d e> where a is emulated phy id - must be unique to among
             all specified fixed-links, b is duplex - 0 half, 1 full, c is
             link speed - 10/100/1000/2500, d is pause - 0 no pause, 1 pause,
             e is asym_pause - 0 no asym_pause, 1 asym_pause.

  - phy-handle
     Usage: optional
     Value type: <phandle>
     Definition: The phandle for the PHY connected to this l2switch port.


    Note: All other standard properties (see the ePAPR) are allowed but are
    optional.
```

## Documentation/devicetree/bindings/powerpc/fsl/rman.txt
```
=================================================================================
Freescale RapidIO Message Manager Device Bindings
Copyright 2015 Freescale Semiconductor Inc.

CONTENTS
  - RMan Node
  - RMan Inbound Block Node
  - RMan Global CFG Node
  - Example

NOTE: The bindings described in this document are preliminary and subject to
change.

=================================================================================
RMan Node

DESCRIPTION

The RapidIO message manager (RMan) supports a message passing programming model
for inter-processor and inter-device communication. Due to the fact RMan has
multiple inbound blocks, the RMan node will have child nodes for each block.
The RMan's revision information can be get from IPBRRO and IPBRR1 registers.

PROPERTIES

  - compatible
	Usage: required
	Value type: <string>
	Definition: Must include "fsl,rman".
	Definition: Must include "fsl,rman" for IP blocks with IP Block
	Revision Register (SRIO IPBRR1) Major ID equal to 0x0a20.

	Optionally, a compatiable string of "fsl,rman-vX.Y" where X is Major
	version in IP Block Revision Register and Y is Minor version.  If this
	compatiable is provided it should be ordered before "fsl,rman".

  - #address-cells
	Usage: required
	Value type: <u32>
	Definition: A standard property. Defines the number of cells for
		representing physical addresses in child nodes. Must have a
		value of 1.

  - #size-cells
	Usage: required
	Value type: <u32>
	Definition: A standard property. Defines the number of cells for
		representing the size of physical addresses in child nodes.
		Must have a value of 1.

  - reg
	Usage: required
	Value type: <prop-encoded-array>
	Definition: A standard property. Specifies the physical address and
		length of the RMan configuration registers within the CCSR
		address space.

  - ranges
	Usage: required
	Value type: <prop-encoded-array>
	Definition: A standard property. Specifies the physical address and=
		length of the RMan memory space.

  - interrupts:
	Usage: required
	Value type: <prop-encoded-array>
	Definition: Interrupt mapping for RMAN error IRQ.

  - fsl,qman-channels-id
	Usage: required
	Value type: <prop-encoded-array>
	Definition: This property represents the ID value for the specific QMan
		dequeue channel(s) asssociate with RMan.  Typically there is a
		dequeue channel per RapidIO port.

=================================================================================
RMan Inbound Block Node

DESCRIPTION

RMan has multiple inbound blocks. Each inbound block has eight classification
units.

PROPERTIES

  - compatible
	Usage: required
	Value type: <string>
	Definition: A standard property. Must include "fsl,rman-inbound-block".

  - reg
	Usage: required
	Value type: <prop-encoded-array>
	Definition: A standard property. Specifies the physical address offset
		and length of the RMan inbound block configuration registers
		within the RMan node's address space.

  - fsl,liodn
	Usage: see definition
	Value type: <u32>
	Definition: The logical I/O device number (LIODN) for this device.  The
		LIODN is a number expressed by this device and used to perform
		look-ups in the IOMMU (PAMU) address table when performing DMAs.
		This property is required if the PAMU is enabled.

Example

inbound-block@0 {
	fsl,liodn = <203>;
	compatible = "fsl,rman-inbound-block";
	reg = <0x0 0x800>;
};

=================================================================================
RMan Global CFG Node

DESCRIPTION

This node describes the RMan global registers located within the first 4K bytes
resource block.

PROPERTIES

  - compatible
	Usage: required
	Value type: <string>
	Definition: A standard property.  Must include "fsl,rman-global-cfg".

  - reg
	Usage: required
	Value type: <prop-encoded-array>
	Definition: A standard property. Specifies the physical address offset
		and length of the RMan global configuration registers within the
		RMan node's address space.

Example

global-cfg@b00 {
	compatible = "fsl,rman-global-cfg";
	reg = <0xb00 0x500>;
};

=================================================================================
Example

rman: rman@1e0000 {
	compatible = "fsl,rman";
	#address-cells = <1>;
	#size-cells = <1>;
	ranges = <0x0 0x1e0000 0x20000>;
	reg = <0x1e0000 0x20000>;
	interrupts = <16 2 1 11>; /* err_irq */
	fsl,qman-channels-id = <0x62 0x63>;
	inbound-block@0 {
		fsl,liodn = <203>;
		compatible = "fsl,rman-inbound-block";
		reg = <0x0 0x800>;
	};
	global-cfg@b00 {
		compatible = "fsl,rman-global-cfg";
		reg = <0xb00 0x500>;
	};
	inbound-block@1000 {
		fsl,liodn = <204>;
		compatible = "fsl,rman-inbound-block";
		reg = <0x1000 0x800>;
	};
	inbound-block@2000 {
		fsl,liodn = <205>;
		compatible = "fsl,rman-inbound-block";
		reg = <0x2000 0x800>;
	};
	inbound-block@3000 {
		fsl,liodn = <206>;
		compatible = "fsl,rman-inbound-block";
		reg = <0x3000 0x800>;
	};
};
```

## Documentation/devicetree/bindings/soc/fsl/rcpm.txt
```
* Run Control and Power Management
-------------------------------------------
The RCPM performs all device-level tasks associated with device run control
and power management.

Required properites:
  - reg : Offset and length of the register set of RCPM block.
  - compatible : Sould contain a chip-specific RCPM block compatible string
	and (if applicable) may contain a chassis-version RCPM compatible string.
	Chip-specific strings are of the form "fsl,<chip>-rcpm", such as:
	* "fsl,p2041-rcpm"
	* "fsl,p3041-rcpm"
	* "fsl,p4080-rcpm"
	* "fsl,p5020-rcpm"
	* "fsl,p5040-rcpm"
	* "fsl,t4240-rcpm"
	* "fsl,b4420-rcpm"
	* "fsl,b4860-rcpm"

	Chassis-version strings are of the form "fsl,qoriq-rcpm-<version>",
	such as:
	* "fsl,qoriq-rcpm-1.0": for chassis 1.0 rcpm
	* "fsl,qoriq-rcpm-2.0": for chassis 2.0 rcpm
	* "fsl,qoriq-rcpm-2.1": for chassis 2.1 rcpm

All references to "1.0" and "2.0" refer to the QorIQ chassis version to
which the chip complies.
Chassis Version		Example Chips
---------------		-------------------------------
1.0				p4080, p5020, p5040, p2041, p3041
2.0				t4240, b4860, b4420
2.1				t1040, ls1021

Example:
The RCPM node for T4240:
	rcpm: global-utilities@e2000 {
		compatible = "fsl,t4240-rcpm", "fsl,qoriq-rcpm-2.0";
		reg = <0xe2000 0x1000>;
	};

The RCPM node for P4080:
	rcpm: global-utilities@e2000 {
		compatible = "fsl,qoriq-rcpm-1.0";
		reg = <0xe2000 0x1000>;
	};

* Freescale RCPM Wakeup Source Device Tree Bindings
-------------------------------------------
Required rcpm-wakeup property should be added to a device node if the device
can be used as a wakeup source.

  - rcpm-wakeup: should contain a pointer to the rcpm node and the
	corresponding bit of device in the register.

Example:
	lpuart0: serial@2950000 {
		compatible = "fsl,ls1021a-lpuart";
		reg = <0x0 0x2950000 0x0 0x1000>;
		interrupts = <GIC_SPI 80 IRQ_TYPE_LEVEL_HIGH>;
		clocks = <&sysclk>;
		clock-names = "ipg";
		rcpm-wakeup = <&rcpm 0x0 0x40000000>;
		status = "disabled";
	};
```

## Documentation/devicetree/bindings/tdm/maxim,ds26522.txt
```
* Maxim (Dallas) DS26522 Octal T1/E1/J1 Transceiver

Required properties:
- compatible: Should contain "maxim,ds26522".
- reg: SPI CS
- spi-max-frequency: SPI bus max frequency.

Example:
	slic@2 {
		compatible = "maxim,ds26522";
		reg = <2>;
		spi-max-frequency = <2000000>;
	};
```
