/*
 * T1040D4RDB Link Aggregation Device Tree Source
 *
 * Copyright 2016 Freescale Semiconductor Inc.
 *
 * Redistribution and use in source and binary forms, with or without
 * modification, are permitted provided that the following conditions are met:
 *     * Redistributions of source code must retain the above copyright
 *       notice, this list of conditions and the following disclaimer.
 *     * Redistributions in binary form must reproduce the above copyright
 *       notice, this list of conditions and the following disclaimer in the
 *       documentation and/or other materials provided with the distribution.
 *     * Neither the name of Freescale Semiconductor nor the
 *       names of its contributors may be used to endorse or promote products
 *       derived from this software without specific prior written permission.
 *
 *
 * ALTERNATIVELY, this software may be distributed under the terms of the
 * GNU General Public License ("GPL") as published by the Free Software
 * Foundation, either version 2 of that License or (at your option) any
 * later version.
 *
 * THIS SOFTWARE IS PROVIDED BY Freescale Semiconductor ``AS IS'' AND ANY
 * EXPRESS OR IMPLIED WARRANTIES, INCLUDING, BUT NOT LIMITED TO, THE IMPLIED
 * WARRANTIES OF MERCHANTABILITY AND FITNESS FOR A PARTICULAR PURPOSE ARE
 * DISCLAIMED. IN NO EVENT SHALL Freescale Semiconductor BE LIABLE FOR ANY
 * DIRECT, INDIRECT, INCIDENTAL, SPECIAL, EXEMPLARY, OR CONSEQUENTIAL DAMAGES
 * (INCLUDING, BUT NOT LIMITED TO, PROCUREMENT OF SUBSTITUTE GOODS OR SERVICES;
 * LOSS OF USE, DATA, OR PROFITS; OR BUSINESS INTERRUPTION) HOWEVER CAUSED AND
 * ON ANY THEORY OF LIABILITY, WHETHER IN CONTRACT, STRICT LIABILITY, OR TORT
 * (INCLUDING NEGLIGENCE OR OTHERWISE) ARISING IN ANY WAY OUT OF THE USE OF THIS
 * SOFTWARE, EVEN IF ADVISED OF THE POSSIBILITY OF SUCH DAMAGE.
 */

#include "t1040d4rdb.dts"

/ {
	/* bp dts definition is borrowed from other USDPAA dts */
	bp6: buffer-pool@6 {
		compatible = "fsl,t1040-bpool", "fsl,bpool";
		fsl,bpid = <6>;
		fsl,bpool-ethernet-cfg = <0 0 0 1728 0 0xfeedabba>;
		fsl,bpool-thresholds = <0x100 0x300 0x0 0x0>;
	};

	fsl,dpaa {
		/* There are 1 host port and 3 offline ports (OP) in T1040.
		 * Enabling OP#2 for lag use-case.
		 */
		dpa-fman0-oh@2 {
			compatible = "fsl,dpa-oh";
			/* Define frame queues for the OH port*/
			/* <OH Rx error, OH Rx default> */
			fsl,qman-frame-queues-oh = <0x68 1 0x69 1>;
			fsl,bman-buffer-pools = <&bp6>;
			fsl,qman-frame-queues-tx = <0x90 8>;
			fsl,fman-oh-port = <&fman0_oh2>;
		};
	};
};
