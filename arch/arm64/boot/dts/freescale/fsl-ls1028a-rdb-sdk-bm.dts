// SPDX-License-Identifier: GPL-2.0+
/*
 * DTS file for NXP Layerscape baremetal
 *
 * Copyright 2019-2020 NXP
 *
 * Author: Hongbo Wang <hongbo.wang@nxp.com>
 *
 */

#include "fsl-ls1028a-rdb.dts"

&enetc_pcie {
	status = "disabled";
};
