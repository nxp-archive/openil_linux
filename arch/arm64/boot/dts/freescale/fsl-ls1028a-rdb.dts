/*
 * Freescale ls1028a RDB board device tree source
 *
 * Copyright 2017-2019 NXP
 *
 * SPDX-License-Identifier:	GPL-2.0+
 */

/dts-v1/;

#include "fsl-ls1028a.dtsi"

/ {
	model = "Freescale Layerscape 1028a RDB Board";
	compatible = "fsl,ls1028a-rdb", "fsl,ls1028a";

	aliases {
		spi1 = &dspi;
	};
};

&dspi {
	bus-num = <0>;
	status = "okay";

	dflash0: n25q512a {
		#address-cells = <1>;
		#size-cells = <1>;
		compatible = "spi-flash";
		spi-max-frequency = <3000000>;
		spi-cpol;
		spi-cpha;
		reg = <0>;
	};
};
